## conf/layer.conf
```bitbake
# We have a conf and classes directory, append to BBPATH
BBPATH .= ":${LAYERDIR}"

# We have a recipes directory, add to BBFILES
BBFILES += "${LAYERDIR}/recipes*/*/*.bb ${LAYERDIR}/recipes*/*/*.bbappend ${LAYERDIR}/images/*.bb"

BBFILE_COLLECTIONS += "meta-magic-lantern"
BBFILE_PATTERN_meta-magic-lantern := "^${LAYERDIR}/"
BBFILE_PRIORITY_meta-magic-lantern = "16"

LAYERSERIES_COMPAT_meta-magic-lantern = "dunfell"
```
